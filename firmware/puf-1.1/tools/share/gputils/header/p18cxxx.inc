        LIST
; P18CXXX.INC  Standard Header File, Version 1.00   Microchip Technology, Inc.
        NOLIST

; This header file defines the list of processor specific header files.  It is
; used to include the appropriate header file.

; Note that the processor must be selected before this file is included.  The
; processor may be selected the following ways:

; Using the PIC18C452 as an example
;       1. Command line switch:
;               C:\ MPASM MYFILE.ASM /PIC18C452
;       2. LIST directive in the source file
;               LIST   P=PIC18C452
;       3. Processor Type entry in the MPASM full-screen interface
;       4. Setting the processor in the MPLAB Project Dialog

;==========================================================================
;
;       Revision History
;
;==========================================================================
; Rev:   Date:         Details:                                        Who:
; 1.10   06/13/02      Removing 18F010/18F020    (pas)
;==========================================================================
;
;       Verify Processor
;
;==========================================================================

  IFDEF __18CXX
     INCLUDE <P18C452.INC>
  ENDIF
  IFDEF __18C242
     INCLUDE <P18C242.INC>
  ENDIF
  IFDEF __18F242
     INCLUDE <P18F242.INC>
  ENDIF
  IFDEF __18F248
     INCLUDE <P18F248.INC>
  ENDIF
  IFDEF __18C252
     INCLUDE <P18C252.INC>
  ENDIF
  IFDEF __18F252
     INCLUDE <P18F252.INC>
  ENDIF
  IFDEF __18F258
     INCLUDE <P18F258.INC>
  ENDIF
  IFDEF __18C442
     INCLUDE <P18C442.INC>
  ENDIF
  IFDEF __18F442
     INCLUDE <P18F442.INC>
  ENDIF
  IFDEF __18F448
     INCLUDE <P18F448.INC>
  ENDIF
  IFDEF __18C452
     INCLUDE <P18C452.INC>
  ENDIF
  IFDEF __18F452
     INCLUDE <P18F452.INC>
  ENDIF
  IFDEF __18F458
     INCLUDE <P18F458.INC>
  ENDIF
  IFDEF __18C601
     INCLUDE <P18C601.INC>
  ENDIF
  IFDEF __18C658
     INCLUDE <P18C658.INC>
  ENDIF
  IFDEF __18C801
     INCLUDE <P18C801.INC>
  ENDIF
  IFDEF __18C858
     INCLUDE <P18C858.INC>
  ENDIF
  IFDEF __18F1220
     INCLUDE <P18F1220.INC>
  ENDIF
  IFDEF __18F1320
     INCLUDE <P18F1320.INC>
  ENDIF
  IFDEF __18F2220
     INCLUDE <P18F2220.INC>
  ENDIF
  IFDEF __18F2320
     INCLUDE <P18F2320.INC>
  ENDIF
  IFDEF __18F4220
     INCLUDE <P18F4220.INC>
  ENDIF
  IFDEF __18F4320
     INCLUDE <P18F4320.INC>
  ENDIF
  IFDEF __18F6520
     INCLUDE <P18F6520.INC>
  ENDIF
  IFDEF __18F6620
     INCLUDE <P18F6620.INC>
  ENDIF
  IFDEF __18F6720
     INCLUDE <P18F6720.INC>
  ENDIF
  IFDEF __18F8520
     INCLUDE <P18F8520.INC>
  ENDIF
  IFDEF __18F8620
     INCLUDE <P18F8620.INC>
  ENDIF
  IFDEF __18F8720
     INCLUDE <P18F8720.INC>
  ENDIF
  IFDEF __18F2439
     INCLUDE <P18F2439.INC>
  ENDIF
  IFDEF __18F2539
     INCLUDE <P18F2539.INC>
  ENDIF
  IFDEF __18F4439
     INCLUDE <P18F4439.INC>
  ENDIF
  IFDEF __18F4539
     INCLUDE <P18F4539.INC>
  ENDIF
  IFDEF __18F8680
     INCLUDE <P18F8680.INC>
  ENDIF
  IFDEF __18F6680
     INCLUDE <P18F6680.INC>
  ENDIF
  IFDEF __18F8585
     INCLUDE <P18F8585.INC>
  ENDIF
  IFDEF __18F6585
     INCLUDE <P18F6585.INC>
  ENDIF
  IFDEF __18F6621
     INCLUDE <P18F6621.INC>
  ENDIF
  IFDEF __18F8621
     INCLUDE <P18F8621.INC>
  ENDIF
  IFDEF __18F6525
     INCLUDE <P18F6525.INC>
  ENDIF
  IFDEF __18F8525
     INCLUDE <P18F8525.INC>
  ENDIF
  IFDEF __18F2331
     INCLUDE <P18F2331.INC>
  ENDIF
  IFDEF __18F2431
     INCLUDE <P18F2431.INC>
  ENDIF
  IFDEF __18F4331
     INCLUDE <P18F4331.INC>
  ENDIF
  IFDEF __18F4431
     INCLUDE <P18F4431.INC>
  ENDIF
  IFDEF __18F2515
     INCLUDE <P18F2515.INC>
  ENDIF
  IFDEF __18F2525
     INCLUDE <P18F2525.INC>
  ENDIF
  IFDEF __18F2610
     INCLUDE <P18F2610.INC>
  ENDIF
  IFDEF __18F2620
     INCLUDE <P18F2620.INC>
  ENDIF
  IFDEF __18F4515
     INCLUDE <P18F4515.INC>
  ENDIF
  IFDEF __18F4525
     INCLUDE <P18F4525.INC>
  ENDIF
  IFDEF __18F4610
     INCLUDE <P18F4610.INC>
  ENDIF
  IFDEF __18F4620
     INCLUDE <P18F4620.INC>
  ENDIF
  IFDEF __18F6410
     INCLUDE <P18F6410.INC>
  ENDIF
  IFDEF __18F6490
     INCLUDE <P18F6490.INC>
  ENDIF
  IFDEF __18F8410
     INCLUDE <P18F8410.INC>
  ENDIF
  IFDEF __18F8490
     INCLUDE <P18F8490.INC>
  ENDIF
  IFDEF __18F2585
     INCLUDE <P18F2585.INC>
  ENDIF
  IFDEF __18F2680
     INCLUDE <P18F2680.INC>
  ENDIF
  IFDEF __18F2681
     INCLUDE <P18F2681.INC>
  ENDIF
  IFDEF __18F4585
     INCLUDE <P18F4585.INC>
  ENDIF
  IFDEF __18F4680
     INCLUDE <P18F4680.INC>
  ENDIF
  IFDEF __18F4681
     INCLUDE <P18F4681.INC>
  ENDIF
  IFDEF __18F2510
     INCLUDE <P18F2510.INC>
  ENDIF
  IFDEF __18F2520
     INCLUDE <P18F2520.INC>
  ENDIF
  IFDEF __18F4510
     INCLUDE <P18F4510.INC>
  ENDIF
  IFDEF __18F4520
     INCLUDE <P18F4520.INC>
  ENDIF
  IFDEF __18F2455
     INCLUDE <P18F2455.INC>
  ENDIF
  IFDEF __18F2550
     INCLUDE <P18F2550.INC>
  ENDIF
  IFDEF __18F4455
     INCLUDE <P18F4455.INC>
  ENDIF
  IFDEF __18F4550
     INCLUDE <P18F4550.INC>
  ENDIF
  IFDEF __18F2410
     INCLUDE <P18F2410.INC>
  ENDIF
  IFDEF __18F2420
     INCLUDE <P18F2420.INC>
  ENDIF
  IFDEF __18F4410
     INCLUDE <P18F4410.INC>
  ENDIF
  IFDEF __18F4420
     INCLUDE <P18F4420.INC>
  ENDIF
  IFDEF __18F2480
     INCLUDE <P18F2480.INC>
  ENDIF
  IFDEF __18F2580
     INCLUDE <P18F2580.INC>
  ENDIF
  IFDEF __18F4480
     INCLUDE <P18F4480.INC>
  ENDIF
  IFDEF __18F4580
     INCLUDE <P18F4580.INC>
  ENDIF
  IFDEF __18F6310
     INCLUDE <P18F6310.INC>
  ENDIF
  IFDEF __18F6390
     INCLUDE <P18F6390.INC>
  ENDIF
  IFDEF __18F8310
     INCLUDE <P18F8310.INC>
  ENDIF
  IFDEF __18F8390
     INCLUDE <P18F8390.INC>
  ENDIF
  IFDEF __18F6627
     INCLUDE <P18F6627.INC>
  ENDIF
  IFDEF __18F6722
     INCLUDE <P18F6722.INC>
  ENDIF
  IFDEF __18F8627
     INCLUDE <P18F8627.INC>
  ENDIF
  IFDEF __18F8722
     INCLUDE <P18F8722.INC>
  ENDIF
  IFDEF __18F65J10
     INCLUDE <P18F65J10.INC>
  ENDIF
  IFDEF __18F65J15
     INCLUDE <P18F65J15.INC>
  ENDIF
  IFDEF __18F66J10
     INCLUDE <P18F66J10.INC>
  ENDIF
  IFDEF __18F66J15
     INCLUDE <P18F66J15.INC>
  ENDIF
  IFDEF __18F67J10
     INCLUDE <P18F67J10.INC>
  ENDIF
  IFDEF __18F85J10
     INCLUDE <P18F85J10.INC>
  ENDIF
  IFDEF __18F85J15
     INCLUDE <P18F85J15.INC>
  ENDIF
  IFDEF __18F86J10
     INCLUDE <P18F86J10.INC>
  ENDIF
  IFDEF __18F86J15
     INCLUDE <P18F86J15.INC>
  ENDIF
  IFDEF __18F87J10
     INCLUDE <P18F87J10.INC>
  ENDIF
  IFDEF __18F6527
     INCLUDE <P18F6527.INC>
  ENDIF
  IFDEF __18F6622
     INCLUDE <P18F6622.INC>
  ENDIF
  IFDEF __18F8527
     INCLUDE <P18F8527.INC>
  ENDIF
  IFDEF __18F8622
     INCLUDE <P18F8622.INC>
  ENDIF
  IFDEF __18F24J10
     INCLUDE <P18F24J10.INC>
  ENDIF
  IFDEF __18F25J10
     INCLUDE <P18F25J10.INC>
  ENDIF
  IFDEF __18F44J10
     INCLUDE <P18F44J10.INC>
  ENDIF
  IFDEF __18F45J10
     INCLUDE <P18F45J10.INC>
  ENDIF
  IFDEF __18F2221
     INCLUDE <P18F2221.INC>
  ENDIF
  IFDEF __18F2321
     INCLUDE <P18F2321.INC>
  ENDIF
  IFDEF __18F4221
     INCLUDE <P18F4221.INC>
  ENDIF
  IFDEF __18F4321
     INCLUDE <P18F4321.INC>
  ENDIF
  IFDEF __18F97J60
     INCLUDE <P18F97J60.INC>
  ENDIF
  IFDEF __18F96J65
     INCLUDE <P18F96J65.INC>
  ENDIF
  IFDEF __18F96J60
     INCLUDE <P18F96J60.INC>
  ENDIF
  IFDEF __18F87J60
     INCLUDE <P18F87J60.INC>
  ENDIF
  IFDEF __18F86J65
     INCLUDE <P18F86J65.INC>
  ENDIF
  IFDEF __18F86J60
     INCLUDE <P18F86J60.INC>
  ENDIF
  IFDEF __18F67J60
     INCLUDE <P18F67J60.INC>
  ENDIF
  IFDEF __18F66J65
     INCLUDE <P18F66J65.INC>
  ENDIF
  IFDEF __18F66J60
     INCLUDE <P18F66J60.INC>
  ENDIF
  IFDEF __18F1331
     INCLUDE <P18F1331.INC>
  ENDIF
  IFDEF __18F1330
     INCLUDE <P18F1330.INC>
  ENDIF
  IFDEF __18F1231
     INCLUDE <P18F1231.INC>
  ENDIF
  IFDEF __18F1230
     INCLUDE <P18F1230.INC>
  ENDIF
  IFDEF __18F4450
     INCLUDE <P18F4450.INC>
  ENDIF
  IFDEF __18F2450
     INCLUDE <P18F2450.INC>
  ENDIF
  IFDEF __18F4523
     INCLUDE <P18F4523.INC>
  ENDIF
  IFDEF __18F4423
     INCLUDE <P18F4423.INC>
  ENDIF
  IFDEF __18F2523
     INCLUDE <P18F2523.INC>
  ENDIF
  IFDEF __18F2423
     INCLUDE <P18F2423.INC>
  ENDIF
  IFDEF __18F85J90
     INCLUDE <P18F85J90.INC>
  ENDIF
  IFDEF __18F84J90
     INCLUDE <P18F84J90.INC>
  ENDIF
  IFDEF __18F83J90
     INCLUDE <P18F83J90.INC>
  ENDIF
  IFDEF __18F65J90
     INCLUDE <P18F65J90.INC>
  ENDIF
  IFDEF __18F64J90
     INCLUDE <P18F64J90.INC>
  ENDIF
  IFDEF __18F63J90
     INCLUDE <P18F63J90.INC>
  ENDIF
  IFDEF __18F45K20
     INCLUDE <P18F45K20.INC>
  ENDIF
  IFDEF __18F25K20
     INCLUDE <P18F25K20.INC>
  ENDIF
  IFDEF __18F4685
     INCLUDE <P18F4685.INC>
  ENDIF
  IFDEF __18F2685
     INCLUDE <P18F2685.INC>
  ENDIF
  IFDEF __18F85J11
     INCLUDE <P18F85J11.INC>
  ENDIF
  IFDEF __18F84J11
     INCLUDE <P18F84J11.INC>
  ENDIF
  IFDEF __18F83J11
     INCLUDE <P18F83J11.INC>
  ENDIF
  IFDEF __18F65J11
     INCLUDE <P18F65J11.INC>
  ENDIF
  IFDEF __18F64J11
     INCLUDE <P18F64J11.INC>
  ENDIF
  IFDEF __18F63J11
     INCLUDE <P18F63J11.INC>
  ENDIF
  IFDEF __18F4682
     INCLUDE <P18F4682.INC>
  ENDIF
  IFDEF __18F2682
     INCLUDE <P18F2682.INC>
  ENDIF
  IFDEF __18F87J50
     INCLUDE <P18F87J50.INC>
  ENDIF
  IFDEF __18F86J55
     INCLUDE <P18F86J55.INC>
  ENDIF
  IFDEF __18F86J50
     INCLUDE <P18F86J50.INC>
  ENDIF
  IFDEF __18F85J50
     INCLUDE <P18F85J50.INC>
  ENDIF
  IFDEF __18F67J50
     INCLUDE <P18F67J50.INC>
  ENDIF
  IFDEF __18F66J55
     INCLUDE <P18F66J55.INC>
  ENDIF
  IFDEF __18F66J50
     INCLUDE <P18F66J50.INC>
  ENDIF
  IFDEF __18F65J50
     INCLUDE <P18F65J50.INC>
  ENDIF
  IFDEF __18F87J11
     INCLUDE <P18F87J11.INC>
  ENDIF
  IFDEF __18F86J16
     INCLUDE <P18F86J16.INC>
  ENDIF
  IFDEF __18F86J11
     INCLUDE <P18F86J11.INC>
  ENDIF
  IFDEF __18F67J11
     INCLUDE <P18F67J11.INC>
  ENDIF
  IFDEF __18F66J16
     INCLUDE <P18F66J16.INC>
  ENDIF
  IFDEF __18F66J11
     INCLUDE <P18F66J11.INC>
  ENDIF

